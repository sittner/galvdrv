## esp32-loader/main/Kconfig.projbuild
```kconfig
menu "ESP32 Loader Configuration"

config LOADER_AP_SSID
    string "WiFi AP SSID"
    default "galvo-dev"

config LOADER_AP_PASSWORD
    string "WiFi AP password (empty for open AP)"
    default "galvo1234"

config LOADER_AP_CHANNEL
    int "WiFi AP channel"
    range 1 13
    default 1

config LOADER_HTTP_SERVER_PORT
    int "HTTP server port"
    range 1 65535
    default 80

config LOADER_MAX_UPLOAD_BYTES
    int "Maximum uploaded bitstream size (bytes)"
    range 1024 16777216
    default 4194304

config LOADER_JTAG_GPIO_TCK
    int "JTAG TCK GPIO"
    range 0 48
    default 4

config LOADER_JTAG_GPIO_TMS
    int "JTAG TMS GPIO"
    range 0 48
    default 5

config LOADER_JTAG_GPIO_TDI
    int "JTAG TDI GPIO"
    range 0 48
    default 6

config LOADER_JTAG_GPIO_TDO
    int "JTAG TDO GPIO"
    range 0 48
    default 7

config SIGGEN_SPI_GPIO_SCLK
    int "Signal generator SPI SCLK GPIO"
    range 0 48
    default 10

config SIGGEN_SPI_GPIO_MOSI
    int "Signal generator SPI MOSI GPIO"
    range 0 48
    default 11

config SIGGEN_SPI_GPIO_MISO
    int "Signal generator SPI MISO GPIO"
    range 0 48
    default 12

config SIGGEN_SPI_GPIO_CS
    int "Signal generator SPI CS GPIO"
    range 0 48
    default 13

config SIGGEN_SPI_CLOCK_HZ
    int "Signal generator SPI clock (Hz)"
    range 100000 20000000
    default 2000000

endmenu
```

## esp32-loader/sdkconfig.defaults
```kconfig
CONFIG_IDF_TARGET="esp32s3"
CONFIG_PARTITION_TABLE_SINGLE_APP=y
CONFIG_ESP_MAIN_TASK_STACK_SIZE=8192
```
